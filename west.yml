## west.yml
```yaml
# Copyright (c) 2022 Dhruva Gole <goledhruva@gmail.com>
# SPDX-License-Identifier: Apache-2.0

# NOTE: This is created to be used for CI/CD workflow. So use it only
# if you are in the zephyrproject directory or else things may break.

manifest:
  self:
    path: modules/lib/ArduinoCore-zephyr

  remotes:
    - name: infineon-github
      url-base: https://github.com/Infineon
    - name: zephyrproject-rtos
      url-base: https://github.com/zephyrproject-rtos
    - name: arduino
      url-base: https://github.com/arduino
    - name: facchinm
      url-base: https://github.com/facchinm
    - name: pillo79
      url-base: https://github.com/pillo79

  projects:
    - name: zephyr
      remote: arduino
      revision: zephyr-arduino-v4.5.0
      import:
        name-allowlist:
          - cmsis
          - cmsis_6
          - littlefs
          - tinycrypt
          - mbedtls
          - tf-psa-crypto
          - segger
          - thrift
          - mcuboot
          - nanopb
          - lvgl
          - fatfs
        path-allowlist:
          - modules/hal/*

        # The actual list of enabled HALs is set by extra/bootstrap.sh via
        # the 'manifest.project-filter' config. Enable all Zephyr HALs with:
        #
        #   west config -d manifest.project-filter

    - name: cannectivity
      path: modules/lib/cannectivity
      url: https://github.com/CANnectivity/cannectivity.git
      revision: main

    # Infineon ML modules; cloned into hal_infineon (imported from Zephyr), which must stay first.
    - name: ifx-ml-middleware
      remote: infineon-github
      repo-path: ifx-zephyr-lib
      revision: 9b3b3694e95d447f099ba53298832ecfd9d4f5a3
      path: modules/hal/infineon/ml-middleware

    - name: ifx-ml-tflite-micro
      remote: infineon-github
      repo-path: ifx-zephyr-lib
      revision: 8ffc980955b5dcb006c10fa01f5534eb4984e6fd
      path: modules/hal/infineon/ml-tflite-micro

    - name: mtb-ml-middleware
      remote: infineon-github
      repo-path: ml-middleware
      revision: release-v3.2.0
      path: modules/hal/infineon/ml-middleware/mtb-ml-middleware

    - name: mtb-ml-tflite-micro
      remote: infineon-github
      repo-path: ml-tflite-micro
      revision: release-v3.2.0
      path: modules/hal/infineon/ml-tflite-micro/mtb-ml-tflite-micro

    - name: mtb-dsl-pse8xxgp
      remote: infineon-github
      repo-path: mtb-dsl-pse8xxgp
      revision: release-v1.2.0
      path: modules/lib/mtb-dsl-pse8xxgp
```
